char a[][4] = {
  {'.','-','*','*'},//A
  {'-','.','.','.'},//B
  {'-','.','-','.'},//C
  {'-','.','.','*'},//D
  {'.','*','*','*'},//E
  {'.','.','-','.'},//F
  {'-','-','.','*'},//G
  {'.','.','.','.'},//H
  {'.','.','*','*'},//I
  {'.','-','-','-'},//J
  {'-','.','-','*'},//K
  {'.','-','.','.'},//L
  {'-','-','*','*'},//M
  {'-','.','*','*'},//N
  {'-','-','-','*'},//O
  {'.','-','-','.'},//P
  {'-','-','.','-'},//Q
  {'.','-','.','*'},//R
  {'.','.','.','*'},//S
  {'-','*','*','*'},//T
  {'.','.','-','*'},//U
  {'.','.','.','-'},//V
  {'.','-','-','*'},//W
  {'-','.','.','-'},//X
  {'-','.','-','-'},//Y
  {'-','-','.','.'} //Z
  };
void setup() {
  Serial.begin(9600);

}

void loop() {
  String str = "";
  String morse = "";
  int i,t,temp = 0;
  int n=0;
  while(Serial.available()>0){
    temp=1;//判断是否有数据传入
    str+=char(Serial.read());//将传入数据存入字符串
    delay(2);
    n++;
    }
    if(temp){
      for(i=0;i<n;i++)
      {
        for(t=0;t<4;t++)
        {if(str[i]>='a'&&str[i]<='z')
        {
          morse+=char(a[int(str[i]-97)][t]);
          }
          }
          morse+=' ';//空格
          }
          Serial.println(morse);//串口传入
          }
          delay(2);

}
